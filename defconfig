## defconfig
```kconfig
BR2_arm=y
BR2_cortex_a7=y
BR2_ARM_FPU_VFPV4=y
BR2_TOOLCHAIN_EXTERNAL=y
BR2_TOOLCHAIN_EXTERNAL_CUSTOM=y
BR2_TOOLCHAIN_EXTERNAL_PATH="mobiletek/linux64"
BR2_TOOLCHAIN_EXTERNAL_CUSTOM_PREFIX="$(ARCH)-openwrt-linux"
BR2_TOOLCHAIN_EXTERNAL_GCC_4_9=y
BR2_TOOLCHAIN_EXTERNAL_HEADERS_3_10=y
BR2_TOOLCHAIN_EXTERNAL_WCHAR=y
BR2_TOOLCHAIN_EXTERNAL_HAS_SSP=y
BR2_INIT_NONE=y
# BR2_TARGET_ENABLE_ROOT_LOGIN is not set
BR2_ROOTFS_OVERLAY="${BUILD_DIR}/rootfs-mmp"
BR2_ROOTFS_PRE_BUILD_SCRIPT="board/mobiletek/asr1803/post-build.sh"
BR2_ROOTFS_POST_BUILD_SCRIPT="board/mobiletek/asr1803/post-run.sh"
BR2_ROOTFS_POST_IMAGE_SCRIPT="board/mobiletek/asr1803/post-image.sh"
BR2_LINUX_KERNEL=y
BR2_LINUX_KERNEL_LOCAL_DIRECTORY=y
BR2_LINUX_KERNEL_LOCAL_DIRECTORY_LOCATION="mobiletek/kernel"
BR2_LINUX_KERNEL_USE_CUSTOM_CONFIG=y
BR2_LINUX_KERNEL_CUSTOM_CONFIG_FILE="board/mobiletek/asr1803/linux_config"
# BR2_PACKAGE_BUSYBOX is not set
BR2_PACKAGE_HELLOWORLD=y
BR2_TARGET_ROOTFS_SQUASHFS=y
BR2_TARGET_ROOTFS_SQUASHFS_BS_64K=y
BR2_TARGET_ROOTFS_SQUASHFS4_XZ=y
BR2_TARGET_ROOTFS_UBI=y
BR2_TARGET_ROOTFS_UBI_SUBSIZE=2048
BR2_TARGET_ROOTFS_UBI_USE_CUSTOM_CONFIG=y
BR2_TARGET_ROOTFS_UBI_CUSTOM_CONFIG_FILE="board/mobiletek/asr1803/ubinize-oem.cfg"
BR2_TARGET_ROOTFS_UBIFS_LEBSIZE=0x1f000
BR2_TARGET_ROOTFS_UBIFS_MAXLEBCNT=44
BR2_TARGET_CUSTOM_ROOTFS_DIR_OPTS="board/mobiletek/asr1803/usrfs"
BR2_TARGET_UBOOT=y
BR2_TARGET_UBOOT_BOARDNAME="falcon_p401"
BR2_TARGET_UBOOT_LOCAL_DIRECTORY=y
BR2_TARGET_UBOOT_CUSTOM_REPO_URL="mobiletek/uboot"
```

## package/helloworld/Config.in
```kconfig
config BR2_PACKAGE_HELLOWORLD
bool "helloworld"
help
  This is a demo to add myown helloworld.
```

## package/lynq-at/Config.in
```kconfig
config BR2_PACKAGE_LYNQ_AT
bool "AT command sample."
help
  This is a demo to AT.
```

## package/lynq-audio/Config.in
```kconfig
config BR2_PACKAGE_LYNQ_AUDIO
bool "Audio sample."
help
  This is a demo to audio.
```

## package/lynq-ecall/Config.in
```kconfig
config BR2_PACKAGE_LYNQ_ECALL
bool "Ecall sample."
help
  This is a demo to ecall.
```

## package/lynq-ftp/Config.in
```kconfig
config BR2_PACKAGE_LYNQ_FTP
bool "Ftp client sample."
help
  This is a demo to ftp client.
```

## package/lynq-input/Config.in
```kconfig
config BR2_PACKAGE_LYNQ_INPUT
bool "Input sample."
help
  This is a demo to input.
```

## package/lynq-net-control/Config.in
```kconfig
config BR2_PACKAGE_LYNQ_NET_CONTROL
bool "Network control sample."
help
  This is a demo to network control.
```

## package/lynq-polarssl/Config.in
```kconfig
config BR2_PACKAGE_LYNQ_POLARSSL
bool "Polarssl sample."
help
  This is a demo to polarssl.
```

## package/lynq-pthread/Config.in
```kconfig
config BR2_PACKAGE_LYNQ_PTHREAD
bool "Pthread sample."
help
  This is a demo to pthread.
```
